## configs/linaro_arm_defconfig
```kconfig
CONFIG_ARCH_ARM=y
CONFIG_BOARD_HAVE_BLUETOOTH_LINUX=n
CONFIG_QCOM_WIFI=y
CONFIG_TI_WILINK_WIFI=y
CONFIG_SENSOR=y

CONFIG_BOARD_GPU_DRIVERS="freedreno virgl etnaviv imx"
CONFIG_TARGET_USES_HWC2=y
CONFIG_DEX_PREOPT=y
CONFIG_BOARD_SYSTEMIMAGE_PARTITION_SIZE=1100000000
```
